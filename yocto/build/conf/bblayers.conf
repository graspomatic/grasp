## yocto/build/conf/bblayers.conf
```bitbake
# POKY_BBLAYERS_CONF_VERSION is increased each time build/conf/bblayers.conf
# changes incompatibly
POKY_BBLAYERS_CONF_VERSION = "2"

BBPATH = "${TOPDIR}"
BBFILES ?= ""

BBLAYERS ?= " \
  /home/sheinb/source/poky/meta \
  /home/sheinb/source/poky/meta-poky \
  /home/sheinb/source/poky/meta-yocto-bsp \
  "
BBLAYERS += "/home/sheinb/source/poky/meta-intel"
BBLAYERS += "/home/sheinb/source/poky/meta-openembedded/meta-oe"
BBLAYERS += "/home/sheinb/source/poky/meta-openembedded/meta-python"
BBLAYERS += "/home/sheinb/source/poky/meta-openembedded/meta-networking"
BBLAYERS += "/home/sheinb/source/poky/meta-graspomatic"

IMAGE_INSTALL_append = " linux-firmware intel-microcode glibc-utils glibc-binary-localedata-en-us localedef haveged upm mraa libevent libev-dev jansson zeromq redis hiredis webdis python3 python3-setuptools python3-cython python3-numpy python3-pyzmq python3-redis python3-aioredis python3-pyyaml python3-pyserial rng-tools i2c-tools tcl git mosquitto mosquitto-clients paho-mqtt-c paho-mqtt-cpp python3-paho-mqtt libgpiod cmake zile zeromq-dev cppzmq-dev tmux"
BBLAYERS += "/home/sheinb/source/poky/build/workspace"
```

## yocto/meta-graspomatic/conf/layer.conf
```bitbake
# We have a conf and classes directory, add to BBPATH
BBPATH .= ":${LAYERDIR}"

# We have recipes-* directories, add to BBFILES
BBFILES += "${LAYERDIR}/recipes-*/*/*.bb \
            ${LAYERDIR}/recipes-*/*/*.bbappend"

BBFILE_COLLECTIONS += "meta-graspomatic"
BBFILE_PATTERN_meta-graspomatic = "^${LAYERDIR}/"
BBFILE_PRIORITY_meta-graspomatic = "6"

LAYERDEPENDS_meta-graspomatic = "core"
LAYERSERIES_COMPAT_meta-graspomatic = "warrior"
```
